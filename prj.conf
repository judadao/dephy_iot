## CMakeLists.txt
```
cmake_minimum_required(VERSION 3.20.0)

find_package(Zephyr REQUIRED HINTS $ENV{ZEPHYR_BASE})
project(dephy_iot)

target_sources(app PRIVATE
  src/iot.c
  src/mqtt.c
  src/modbus.c
  src/snmp.c
  src/main.c
)

target_include_directories(app PRIVATE
  ${CMAKE_CURRENT_SOURCE_DIR}/include
)
```

## Kconfig
```
mainmenu "Dephy IoT"

source "Kconfig.zephyr"
rsource "zephyr/Kconfig"
```

## prj.conf
```kconfig
CONFIG_DEPHY_IOT=y
CONFIG_DEPHY_IOT_MQTT=y
CONFIG_DEPHY_IOT_MQTT_MIN_BROKER=y
CONFIG_MQTT_MIN_BROKER=y
CONFIG_DEPHY_IOT_MODBUS=n
CONFIG_DEPHY_IOT_MODBUS_ZEPHYR_ESP32=n
CONFIG_DEPHY_IOT_SNMP=n
```

## src/main.c
```c
#include "dephy_iot/iot.h"

#include <zephyr/kernel.h>
#include <zephyr/sys/printk.h>

int main(void)
{
    struct dephy_iot_config config = {
        .enabled_protocols = 0u
#if defined(CONFIG_DEPHY_IOT_MQTT)
            | DEPHY_IOT_PROTOCOL_MQTT
#endif
#if defined(CONFIG_DEPHY_IOT_MODBUS)
            | DEPHY_IOT_PROTOCOL_MODBUS
#endif
#if defined(CONFIG_DEPHY_IOT_SNMP)
            | DEPHY_IOT_PROTOCOL_SNMP
#endif
    };

    printk("dephy_iot starting\n");
    (void)dephy_iot_init(&config);

    if (dephy_iot_protocol_enabled(DEPHY_IOT_PROTOCOL_MQTT)) {
        printk("dephy_iot mqtt enabled\n");
    }
    if (dephy_iot_protocol_enabled(DEPHY_IOT_PROTOCOL_MODBUS)) {
        printk("dephy_iot modbus enabled\n");
    }
    if (dephy_iot_protocol_enabled(DEPHY_IOT_PROTOCOL_SNMP)) {
        printk("dephy_iot snmp enabled\n");
    }

    return 0;
}
```

## src/iot.c
```c
#include "dephy_iot/iot.h"

#include "dephy_iot/modbus.h"
#include "dephy_iot/mqtt.h"
#include "dephy_iot/snmp.h"

static uint32_t active_protocols;

int dephy_iot_init(const struct dephy_iot_config *config)
{
    if (config == 0) {
        return DEPHY_IOT_ERR_INVALID_ARG;
    }

    active_protocols = config->enabled_protocols;
    return DEPHY_IOT_OK;
}

int dephy_iot_start(uint32_t protocol)
{
    if (!dephy_iot_protocol_enabled(protocol)) {
        return DEPHY_IOT_ERR_NOT_ENABLED;
    }

    switch (protocol) {
    case DEPHY_IOT_PROTOCOL_MQTT:
        return dephy_iot_mqtt_start();
    case DEPHY_IOT_PROTOCOL_MODBUS:
        return dephy_iot_modbus_start();
    case DEPHY_IOT_PROTOCOL_SNMP:
        return dephy_iot_snmp_start();
    default:
        return DEPHY_IOT_ERR_INVALID_ARG;
    }
}

bool dephy_iot_protocol_enabled(uint32_t protocol)
{
    return protocol != 0u && (active_protocols & protocol) == protocol;
}

const char *dephy_iot_protocol_name(uint32_t protocol)
{
    switch (protocol) {
    case DEPHY_IOT_PROTOCOL_MQTT:
        return "mqtt";
    case DEPHY_IOT_PROTOCOL_MODBUS:
        return "modbus";
    case DEPHY_IOT_PROTOCOL_SNMP:
        return "snmp";
    default:
        return "unknown";
    }
}
```

## src/modbus.c
```c
#include "dephy_iot/modbus.h"

#include "dephy_iot/iot.h"

#if defined(CONFIG_DEPHY_IOT_MODBUS_ZEPHYR_ESP32)
#include "modbus_zephyr_esp32/modbus.h"
#endif

static struct dephy_iot_modbus_config modbus_config = {
    .unit_id = 1,
    .baudrate = 115200,
    .tcp_port = 502,
};

int dephy_iot_modbus_init(const struct dephy_iot_modbus_config *config)
{
    if (config != 0) {
        modbus_config = *config;
    }

    return DEPHY_IOT_OK;
}

int dephy_iot_modbus_start(void)
{
#if defined(CONFIG_DEPHY_IOT_MODBUS)
#if defined(CONFIG_DEPHY_IOT_MODBUS_ZEPHYR_ESP32)
    struct modbus_zephyr_esp32_config backend_config = {
        .mode = MODBUS_ZEPHYR_ESP32_MODE_RTU,
        .unit_id = modbus_config.unit_id,
        .baudrate = modbus_config.baudrate,
        .tcp_port = modbus_config.tcp_port,
    };
    int rc = modbus_zephyr_esp32_init(&backend_config);
    if (rc != MODBUS_ZEPHYR_ESP32_OK) {
        return DEPHY_IOT_ERR_INVALID_ARG;
    }
    return modbus_zephyr_esp32_start() == MODBUS_ZEPHYR_ESP32_OK
        ? DEPHY_IOT_OK
        : DEPHY_IOT_ERR_UNSUPPORTED;
#else
    return DEPHY_IOT_OK;
#endif
#else
    return DEPHY_IOT_ERR_NOT_ENABLED;
#endif
}

unsigned short dephy_iot_modbus_crc16(const unsigned char *data,
                                      unsigned int len)
{
    unsigned short crc = 0xffffu;
    unsigned int i;
    unsigned int bit;

    if (data == 0 && len != 0u) {
        return 0u;
    }

    for (i = 0; i < len; ++i) {
        crc ^= data[i];
        for (bit = 0; bit < 8u; ++bit) {
            if ((crc & 0x0001u) != 0u) {
                crc = (unsigned short)((crc >> 1) ^ 0xa001u);
            } else {
                crc = (unsigned short)(crc >> 1);
            }
        }
    }

    return crc;
}

int dephy_iot_modbus_parse_rtu_response(const unsigned char *frame,
                                        unsigned int len,
                                        struct dephy_iot_modbus_response *out)
{
    unsigned short expected_crc;
    unsigned short actual_crc;

    if (frame == 0 || out == 0 || len < 5u) {
        return DEPHY_IOT_ERR_INVALID_ARG;
    }

    expected_crc = dephy_iot_modbus_crc16(frame, len - 2u);
    actual_crc = (unsigned short)(frame[len - 2u] | ((unsigned short)frame[len - 1u] << 8));
    if (expected_crc != actual_crc) {
        return DEPHY_IOT_ERR_INVALID_ARG;
    }

    out->unit_id = frame[0];
    out->function = frame[1];
    out->payload = &frame[2];
    out->payload_len = len - 4u;

    if ((out->function & 0x80u) != 0u) {
        return DEPHY_IOT_ERR_UNSUPPORTED;
    }

    return DEPHY_IOT_OK;
}
```

## src/mqtt.c
```c
#include "dephy_iot/mqtt.h"

#include "dephy_iot/iot.h"

#include <stdio.h>

#if defined(CONFIG_DEPHY_IOT_MQTT_MIN_BROKER)
#include "broker.h"
#endif

static struct dephy_iot_mqtt_config mqtt_config = {
    .bind_host = "0.0.0.0",
    .port = 1883,
};

int dephy_iot_mqtt_init(const struct dephy_iot_mqtt_config *config)
{
    if (config != 0) {
        mqtt_config = *config;
    }

    return DEPHY_IOT_OK;
}

int dephy_iot_mqtt_start(void)
{
#if defined(CONFIG_DEPHY_IOT_MQTT)
    (void)mqtt_config;
#if defined(CONFIG_DEPHY_IOT_MQTT_MIN_BROKER)
    return broker_init();
#else
    return DEPHY_IOT_OK;
#endif
#else
    return DEPHY_IOT_ERR_NOT_ENABLED;
#endif
}

int dephy_iot_mqtt_format_topic(char *out,
                                unsigned int out_size,
                                const char *prefix,
                                const char *device,
                                const char *stream)
{
    int written;

    if (out == 0 || out_size == 0 || prefix == 0 || device == 0 || stream == 0) {
        return DEPHY_IOT_ERR_INVALID_ARG;
    }

    written = snprintf(out, out_size, "%s/%s/%s", prefix, device, stream);
    if (written < 0 || (unsigned int)written >= out_size) {
        out[0] = '\0';
        return DEPHY_IOT_ERR_INVALID_ARG;
    }

    return written;
}
```

## src/snmp.c
```c
#include "dephy_iot/snmp.h"

#include "dephy_iot/iot.h"

static struct dephy_iot_snmp_config snmp_config = {
    .community = "public",
};

int dephy_iot_snmp_init(const struct dephy_iot_snmp_config *config)
{
    if (config != 0) {
        snmp_config = *config;
    }

    return DEPHY_IOT_OK;
}

int dephy_iot_snmp_start(void)
{
#if defined(CONFIG_DEPHY_IOT_SNMP)
    (void)snmp_config;
    return DEPHY_IOT_OK;
#else
    return DEPHY_IOT_ERR_NOT_ENABLED;
#endif
}
```
